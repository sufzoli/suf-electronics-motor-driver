#include "sys.h"
#include "gpio.h"
#include "control.h"
#include "display.h"
#include "motor.h"
#include "main.h"
//#include "calibration.h"

unsigned char CONTROL_FUNCTION=CONTROL_FUNCTION_NORMAL;
unsigned char CONTROL_MODE=CONTROL_MODE_AUTO;
unsigned long CONTROL_RPM_SET=0;

void CONTROL_INIT()
{
    _GPIO_SET_PIN_MODE(CONTROL_CAL_PORT, CONTROL_CAL_PIN_NUM, GPIO_PMD_QUASI);
    _GPIO_ENABLE_DEBOUNCE(CONTROL_CAL_PORT, CONTROL_CAL_PIN_NUM);

    _GPIO_SET_PIN_MODE(CONTROL_MODE_RPM_PORT, CONTROL_MODE_RPM_PIN_NUM, GPIO_PMD_QUASI);
    _GPIO_ENABLE_DEBOUNCE(CONTROL_MODE_RPM_PORT, CONTROL_MODE_RPM_PIN_NUM);

    _GPIO_SET_PIN_MODE(CONTROL_MODE_AUTO_PORT, CONTROL_MODE_AUTO_PIN_NUM, GPIO_PMD_QUASI);
    _GPIO_ENABLE_DEBOUNCE(CONTROL_MODE_AUTO_PORT, CONTROL_MODE_AUTO_PIN_NUM);

//    _GPIO_SET_DEBOUNCE_TIME(GPIO_DBNCECON_DBCLKSRC_HCLK, GPIO_DBNCECON_DBCLKSEL_32768);

}

void CONTROL_WORKER()
{
	char ctrl_read;
	while(1)
	{
		ctrl_read = (CONTROL_MODE_AUTO_PIN ? 2 : 0) | (CONTROL_MODE_RPM_PIN ? 1 : 0);
		if(CONTROL_FUNCTION == CONTROL_FUNCTION_NORMAL)
		{
			if(CONTROL_CAL_PIN)
			{
				CONTROL_FUNCTION = CONTROL_FUNCTION_CAL;
//				CALIBRATION_START();
				CONTROL_FUNCTION = CONTROL_FUNCTION_NORMAL;
			}
			if(ctrl_read != CONTROL_MODE)
			{
				CONTROL_RPM_SET = 0;
				GLOBAL_MOTOR_RPMPRESET_CHANGED = 1;
				CONTROL_MODE = ctrl_read < 3 ? ctrl_read : CONTROL_MODE_AUTO;
/*
				switch(ctrl_read)
				{
					case CONTROL_MODE_DUTY:
						CONTROL_MODE = CONTROL_MODE_DUTY;
						break;
					case CONTROL_MODE_AUTO:
						CONTROL_MODE = CONTROL_MODE_AUTO;
						break;
					case CONTROL_MODE_RPM:
						CONTROL_MODE = CONTROL_MODE_RPM;
						break;
					default:
						CONTROL_MODE = CONTROL_MODE_AUTO;
						break;
				}
*/
				DISPLAY_CTRL_MODE(CONTROL_MODE);
//				Motor_GracefullStop();
			}
		}
		SYS_SysTickDelay(1000);
	}
}
